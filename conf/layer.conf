## conf/layer.conf
```bitbake
# We have a conf and classes directory, add to BBPATH
BBPATH .= ":${LAYERDIR}"

# We have recipes-* directories, add to BBFILES
BBFILES += "${LAYERDIR}/recipes-*/*/*.bb \
            ${LAYERDIR}/recipes-*/*/*.bbappend"

BBFILE_COLLECTIONS += "meta-scheduler"
BBFILE_PATTERN_meta-scheduler = "^${LAYERDIR}/"
BBFILE_PRIORITY_meta-scheduler = "6"

LAYERDEPENDS_meta-scheduler = "core openembedded-layer"
LAYERSERIES_COMPAT_meta-scheduler = "nanbield scarthgap"


# Layer conf
MACHINE = "intel-corei7-64"

require ${LAYERDIR}/conf/include/packages.inc
require ${LAYERDIR}/conf/include/build-features.inc
require ${LAYERDIR}/conf/include/image-writter.inc
```
